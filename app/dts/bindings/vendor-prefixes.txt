## app/tests/analog_stream/testcase.yaml
```yaml
tests:
  embarch_dev_bench.analog_stream:
    platform_allow: native_sim
    tags: embarch_dev_bench
```

## app/tests/study_stop/testcase.yaml
```yaml
tests:
  embarch_dev_bench.study_stop:
    platform_allow: native_sim
    tags: embarch_dev_bench
```

## app/tests/usb_ids/testcase.yaml
```yaml
tests:
  embarch_dev_bench.usb_ids:
    platform_allow: native_sim
    tags: embarch_dev_bench
```
