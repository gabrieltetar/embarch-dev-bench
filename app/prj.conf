## CMakeLists.txt
```
# Shared application build (embarch-dev-bench/design.md §2) -- referenced,
# not copied, by every workspace under workspaces/*/app.

cmake_minimum_required(VERSION 3.20.0)

find_package(Zephyr REQUIRED HINTS $ENV{ZEPHYR_BASE})
project(embarch_dev_bench)

target_include_directories(app PRIVATE src)

target_sources(app PRIVATE
  src/main.c
  src/serial_protocol.c
  # embarch-study-designer/design.md §3 decisions 58-62: the `.eap` protocol
  # interpreter. Built for every board, including native_sim -- it is pure C
  # with no BLE and no Zephyr in it, which is what lets the ztest suite drive
  # the semantics directly (there is no real-vs-stub split to make here).
  src/eap_interp.c
  # embarch-dev-bench/design.md §3 decision 38: the Zephyr log backend that
  # forwards CONFIG_LOG output to Core as `LogLine`s. Built for every board,
  # including native_sim -- unlike ble_bridge there is no real-vs-stub
  # split here, since the file itself compiles to no-ops under CONFIG_LOG=n.
  src/dev_bench_log.c
  # decision 44: the advertiser census's Manufacturer Specific Data parsing and
  # rendering. Built for every board including native_sim, same reasoning as
  # eap_interp.c above -- it needs Zephyr's printk/util helpers but nothing
  # from the BT host, so a ztest can pin its offset arithmetic against a
  # synthetic payload on a board where ble_bridge_real.c itself never builds.
  src/scan_seen_mfg.c
  # dev-bench/007: the same failed-name census's bounded, no-partial-fragment
  # name-list append -- built for every board including native_sim, same
  # reasoning as scan_seen_mfg.c above, so a ztest can pin its truncation
  # behaviour even though ble_bridge_real.c itself never builds here.
  src/scan_seen_names.c
)

# embarch-dev-bench/design.md §3 decision 16: ble_bridge_real.c (real Zephyr BT
# host calls) vs ble_bridge_stub.c (canned Outcomes, no BLE host) are separate
# files, not #ifdef branches inside one -- CONFIG_ARCH_POSIX is true exactly
# for native_sim among this project's targets, so it's what picks between them.
if(CONFIG_ARCH_POSIX)
  target_sources(app PRIVATE src/ble_bridge_stub.c)
else()
  target_sources(app PRIVATE src/ble_bridge_real.c)
endif()

# embarch-dev-bench/design.md §3 decision 18: HelloAck.firmware_version.
# Best-effort `git describe`; falls back to a fixed placeholder outside a git
# checkout (e.g. a source tarball) or without git installed.
#
# Real bug found and fixed validating embarch-umbrella's stale-firmware
# doctor check (decision 25) against two real commits: `execute_process`
# only runs at CMake *configure* time, and CMake only reconfigures when one
# of its own tracked dependencies changes -- by default just CMakeLists.txt
# itself, not "the git commit checked out right now." An incremental
# `west build` after a plain `git commit` (no CMakeLists.txt edit) was
# silently re-linking with the *previous* configure's now-stale
# APP_FIRMWARE_VERSION baked in, for every translation unit, not just ones
# that happened to recompile -- exactly the false-negative decision 25's
# check exists to catch, self-inflicted by the build system itself. Fixed by
# making the checked-out commit itself a tracked configure dependency, so a
# commit (or branch switch) that changes it forces a reconfigure and a fresh
# `git describe`. Doesn't cover the plain-`--dirty` case (editing a tracked
# file without staging or committing touches neither of these) -- inherent
# to any git-describe-based scheme, not something CONFIGURE_DEPENDS can fix.
execute_process(
  COMMAND git rev-parse --git-dir
  WORKING_DIRECTORY ${CMAKE_CURRENT_SOURCE_DIR}
  OUTPUT_VARIABLE _embarch_git_dir
  OUTPUT_STRIP_TRAILING_WHITESPACE
  ERROR_QUIET
)
if(_embarch_git_dir)
  if(NOT IS_ABSOLUTE "${_embarch_git_dir}")
    set(_embarch_git_dir "${CMAKE_CURRENT_SOURCE_DIR}/${_embarch_git_dir}")
  endif()
  if(EXISTS "${_embarch_git_dir}/HEAD")
    set_property(DIRECTORY APPEND PROPERTY CMAKE_CONFIGURE_DEPENDS "${_embarch_git_dir}/HEAD")
    file(READ "${_embarch_git_dir}/HEAD" _embarch_head_contents)
    if(_embarch_head_contents MATCHES "^ref: (.*)$")
      string(STRIP "${CMAKE_MATCH_1}" _embarch_head_ref)
      set_property(DIRECTORY APPEND PROPERTY CMAKE_CONFIGURE_DEPENDS "${_embarch_git_dir}/${_embarch_head_ref}")
    endif()
  endif()
  if(EXISTS "${_embarch_git_dir}/index")
    set_property(DIRECTORY APPEND PROPERTY CMAKE_CONFIGURE_DEPENDS "${_embarch_git_dir}/index")
  endif()
endif()

execute_process(
  COMMAND git describe --always --dirty --abbrev=8
  WORKING_DIRECTORY ${CMAKE_CURRENT_SOURCE_DIR}
  OUTPUT_VARIABLE APP_FIRMWARE_VERSION
  OUTPUT_STRIP_TRAILING_WHITESPACE
  ERROR_QUIET
)
if(NOT APP_FIRMWARE_VERSION)
  set(APP_FIRMWARE_VERSION "unknown")
endif()
target_compile_definitions(app PRIVATE APP_FIRMWARE_VERSION="${APP_FIRMWARE_VERSION}")

# Where embarch-study-designer lives. No target links the crate; every target
# reads its wire schema version and its limits and wire enums out of the
# crate's source at configure time, because hand-mirroring them is how the
# schema number went stale twice (see below).
if(DEFINED ENV{EMBARCH_STUDY_DESIGNER_PATH})
  set(ESSD_DIR "$ENV{EMBARCH_STUDY_DESIGNER_PATH}")
else()
  # CMAKE_CURRENT_SOURCE_DIR here is workspaces/<name>/app, itself a
  # symlink to the real app/ (§2's tree). Resolve *that* symlink first, in
  # its own get_filename_component call -- CMake's REALPATH collapses ".."
  # textually before resolving symlinks, so appending "../../embarch-study-
  # designer" and resolving in one call never actually follows the
  # symlink: the ".." components cancel the still-unresolved "app" segment
  # lexically, landing in workspaces/embarch-study-designer (which doesn't
  # exist) instead of climbing out of the real app/'s real parent. Found
  # standing up workspaces/espressif (embarch-dev-bench/design.md's
  # ESP32-C5 interim decision) -- a real CMake-path-resolution bug, latent
  # in every other workspace too, just unnoticed because plain ABSOLUTE
  # (the original code here) happened to still be wrong in the same way
  # nobody hit until a workspace where the surrounding symlink chain
  # differed enough to surface it.
  get_filename_component(ESSD_APP_REALDIR "${CMAKE_CURRENT_SOURCE_DIR}" REALPATH)
  get_filename_component(ESSD_DIR "${ESSD_APP_REALDIR}/../../embarch-study-designer" ABSOLUTE)
endif()
if(NOT EXISTS "${ESSD_DIR}/Cargo.toml")
  message(FATAL_ERROR "embarch-dev-bench: embarch-study-designer not found at ${ESSD_DIR} -- set EMBARCH_STUDY_DESIGNER_PATH if it isn't a sibling of this repo.")
endif()

# Every crate limit and `.eap` wire enum the headers size or decode by,
# derived from the crate rather than typed (decision 56).
include(${CMAKE_CURRENT_SOURCE_DIR}/cmake/crate_limits.cmake)

# The wire schema version `HelloAck` reports (decision 20), read out of the
# crate rather than mirrored by hand in C, for every target.
#
# It was a hand-written `#define`, and it went stale twice: found four bumps
# behind at v4 while implementing v9, fixed to 9, and found stale again at 9
# one bump later when decision 47 took the wire to 10. The comment written the
# first time already said nothing compares this number against the crate --
# which was true, and stayed true, and let the same defect recur immediately.
# Reading it from the crate's own source is what actually closes that, and the
# CONFIGURE_DEPENDS below is what makes an edit to that file re-run this
# instead of leaving a stale value baked in -- the same trap APP_FIRMWARE_VERSION
# hit above. Real boards used to get the number by cross-compiling the crate
# into a staticlib and calling into it (decision 8); that was the only live call
# into the staticlib, so the staticlib is gone and every board reads it here.
set(ESSD_SCHEMA_SRC "${ESSD_DIR}/src/schema_version.rs")
if(NOT EXISTS "${ESSD_SCHEMA_SRC}")
  message(FATAL_ERROR "embarch-dev-bench: ${ESSD_SCHEMA_SRC} not found -- the build reads DEV_BENCH_WIRE_SCHEMA_VERSION from it.")
endif()
set_property(DIRECTORY APPEND PROPERTY CMAKE_CONFIGURE_DEPENDS "${ESSD_SCHEMA_SRC}")
file(READ "${ESSD_SCHEMA_SRC}" _essd_schema_src)
if(NOT _essd_schema_src MATCHES "pub const DEV_BENCH_WIRE_SCHEMA_VERSION: u32 = ([0-9]+)")
  message(FATAL_ERROR "embarch-dev-bench: could not read DEV_BENCH_WIRE_SCHEMA_VERSION out of ${ESSD_SCHEMA_SRC}.")
endif()
target_compile_definitions(app PRIVATE DEV_BENCH_WIRE_SCHEMA_VERSION=${CMAKE_MATCH_1}u)
message(STATUS "embarch-dev-bench: dev-bench wire schema version ${CMAKE_MATCH_1} (from the crate)")
```

## Kconfig
```
# Application Kconfig, sourced automatically by Zephyr for the app directory.
# Shared by every workspace under workspaces/* (each one's app/ is a symlink to
# this directory, embarch-dev-bench/design.md §2).
#
# **An app Kconfig replaces Zephyr's own root, it does not extend it**, so it
# has to `source "Kconfig.zephyr"` itself or every Zephyr symbol vanishes and
# the build aborts on the resulting warnings. Found the hard way adding the
# first symbol here.

mainmenu "embarch-dev-bench"

config EMBARCH_DEV_BENCH_PANIC_AT_HANDSHAKE
	bool "Deliberately k_panic() right after the handshake diagnostic"
	help
	  A debug-only build that crashes on purpose, to exercise decision 38's
	  fatal-error path — the one part of it that has never run (§4).
	  log_panic() switching to synchronous, lock-free writing is what should
	  carry a Zephyr crash dump to Core as LogLines, and nothing has
	  deliberately crashed this firmware since it was written.

	  The question it answers is specific: dev-bench resets mid-study while
	  transmitting a long StepResult, and no crash dump ever arrives. That is
	  either because the reset is not a Zephyr panic, or because this path
	  does not deliver. A build that panics on command distinguishes them —
	  a dump in dev-bench.log means the path works and the real reset is
	  something else (brownout and a watchdog lead the alternatives); no dump
	  means the path itself is broken and the absence of one during a real
	  reset says nothing.

	  Never enable this in a build meant to run a study: it panics at every
	  handshake, so no study can start.
	default n

source "Kconfig.zephyr"
```

## prj.conf
```kconfig
# Shared baseline Kconfig, both workspaces (embarch-dev-bench/design.md §2).

# embarch-dev-bench/design.md §3 decision 7: dev-bench's own log output
# travels as a `LogLine` DevBenchMessage, not raw text -- so nothing else
# (the boot banner, a log backend, the shell) may also write to the link UART
# (the board's `zephyr,console` chosen device, see main.c), or it would corrupt
# COBS framing on the shared wire. No on-board status indication for v1 either
# way (§1) -- this firmware's state is observable only through
# embarch-core/study_status, not local console output.
#
# CONFIG_CONSOLE itself is left alone (native_sim's board Kconfig
# unconditionally force-selects console support and errors out if this tries
# to turn it off) -- disabling the things that actually call printk/log on it
# is enough, since nothing else writes to this UART unprompted.
CONFIG_BOOT_BANNER=n

# --- logging subsystem (design.md §3 decision 38) ------------------------
#
# CONFIG_LOG was `n` here from decision 7 until decision 38, and that had a
# real cost: every LOG_* call in this app and in every Zephyr subsystem it uses
# (BT host, drivers) compiled to nothing, and so did the fatal-error dump, so a
# bench that rebooted or faulted mid-study was *completely silent* from Core's
# side (see main.c's handle_hello for the study that made that concrete). What
# decision 7 actually forbids is raw log text on the shared wire -- not the
# logging subsystem itself. dev_bench_log.c is a log backend that formats each
# record and hands it to a `LogLine`, i.e. exactly the channel decision 7
# specified, so the subsystem can be on without a byte of unframed text ever
# reaching the UART.
CONFIG_LOG=y
CONFIG_LOG_OUTPUT=y

# Deferred, never immediate, and this is load-bearing rather than a default
# worth restating: in immediate mode a backend runs in the caller's context,
# including ISRs and the BT RX thread, and dev_bench_log.c's sink takes
# main.c's `link_tx_mutex` and blocks on uart_poll_out -- illegal from an ISR
# and a latency spike everywhere else. Deferred mode moves every backend call
# onto the log processing thread, which is what makes one link writer more
# (alongside the dispatch loop and the transcript TX thread) safe.
CONFIG_LOG_MODE_DEFERRED=y
CONFIG_LOG_PROCESS_THREAD=y
# log_output formatting plus dbm_encode_frame's call depth on top of it. The
# 1 KB default is Zephyr's sizing for a UART backend that does neither.
CONFIG_LOG_PROCESS_THREAD_STACK_SIZE=2048

# The two backends Zephyr would otherwise enable *by default* on these boards,
# both of which would break something here:
#   - LOG_BACKEND_UART defaults to y whenever there is a UART console, and
#     that console IS this link -- it would write raw text straight onto the
#     COBS wire, the precise failure decision 7 exists to prevent. This line
#     is the single most important one in this block.
#   - LOG_BACKEND_RTT defaults to y on a SEGGER-probed board (the nRF54L15DK).
#     Harmless to the wire, but it costs RAM on boards whose SRAM has already
#     overflowed twice at link time (§3 decision 27, and main.c's tx_scratch
#     consolidation), for a second channel nothing in this suite reads.
CONFIG_LOG_BACKEND_UART=n
CONFIG_LOG_BACKEND_RTT=n

# A *protection*, not a convenience: with this on, any stray printk (Zephyr
# internals, a future line in this app) is routed through the logging
# subsystem and comes out as a framed `LogLine` instead of raw bytes on the
# protocol wire. Without it, one printk anywhere corrupts a frame -- which is
# why the ESP32-C5 overlay's own comment had to record "no stray printk on
# this path -- checked, not assumed" as a prerequisite for reading a decode
# failure. This makes that check unnecessary rather than merely passed.
CONFIG_LOG_PRINTK=y

# --- per-study verbosity (design.md §3 decision 39) ----------------------
#
# Decision 38 shipped CONFIG_LOG_DEFAULT_LEVEL=2, i.e. it kept the link quiet
# by *compiling out* everything above warn. That was the right instinct about
# bandwidth -- a 128-byte LogLine frame is ~1.3 ms of a 1 Mbaud wire the study
# protocol is also using -- and the wrong mechanism: it made the choice once,
# for every study, at whatever level whoever last edited this file picked. A
# BLE-heavy study that needed the BT host's own account of a failure could only
# get it by editing this line, rebuilding, and reflashing the bench.
#
# So: compile everything in, and filter at runtime per study instead. A
# `Study` carries `dev_bench_log_level` (embarch-study-designer's
# DevBenchLogLevel, schema v13), main.c applies it for the study's duration and
# reverts to DEV_BENCH_LOG_BOOT_LEVEL (warn) afterwards, so an idle bench is
# exactly as quiet as it was before this change.
#
# The cost of compiling in DBG is flash, not SRAM -- log format strings live in
# rodata, which on both supported boards is flash-mapped (the ESP32-C5's
# drom0_0_seg was at 0.55% of 8 MB). CONFIG_LOG_RUNTIME_FILTERING's own cost
# *is* SRAM (one filter word per log source), which is why the number below was
# measured against a real build rather than assumed.
CONFIG_LOG_DEFAULT_LEVEL=4
CONFIG_LOG_RUNTIME_FILTERING=y

# embarch-dev-bench/design.md §3 decision 21: `struct dev_bench_message`'s
# union now includes `struct dbm_study_start`, which embeds a full
# DBM_MAX_STEPS_PER_STUDY-sized `struct dbm_step` array (StudyStart's own
# wire worst case, see serial_protocol.h) -- several KB per message value.
# main.c keeps its own message buffers `static` rather than stack locals for
# exactly this reason, but Zephyr's small default main-thread stack (1024
# bytes) isn't enough headroom for the rest of main()'s own call depth
# (ble_bridge_execute, uart_poll_*, etc.) alongside that; bumped well past
# what's actually needed as margin, since both boards have ample RAM for one
# always-alive thread stack.
CONFIG_MAIN_STACK_SIZE=8192

# embarch-dev-bench/design.md §3 decision 29: the link's inbound path must be
# interrupt-driven, not polled. main.c's dispatch loop used to call
# uart_poll_in directly and sleep 1ms whenever the FIFO was momentarily
# empty; at this link's 1 Mbaud that is ~100 bytes of arrivals per sleep,
# against a 128-byte hardware FIFO, so every frame larger than the FIFO lost
# bytes and failed to decode -- presenting as "no message received from
# dev-bench", never as an error. An ISR now drains the FIFO into a ring
# buffer (see main.c's `link_rx_ring`) so frame parsing can never be what the
# FIFO is waiting on.
CONFIG_UART_INTERRUPT_DRIVEN=y
CONFIG_RING_BUFFER=y

# embarch-study-designer/design.md §3 decision 47, embarch-core/design.md §3
# decision 35: `HelloAck` reports this board's own factory-unique chip ID, so
# Core can confirm the board answering on the serial link is the same silicon
# its JTAG probe just verified -- the two are physically separate USB devices
# since the port migration, and nothing observable over USB tied them
# together before this.
#
# main.c's read_hardware_id() is guarded on CONFIG_HWINFO and reports an empty
# string without it, so a board target whose SoC has no hwinfo driver still
# builds and still handshakes -- it just cannot answer the question. native_sim
# is exactly that case.
CONFIG_HWINFO=y
```

## boards/esp32c5_devkitc_esp32c5_hpcore.conf
```kconfig
# ESP32-C5-WROOM-1-specific Kconfig, auto-merged by Zephyr's build system for
# board target esp32c5_devkitc/esp32c5/hpcore (filename matches the full
# target with slashes replaced by underscores, same convention as
# nrf54l15dk_nrf54l15_cpuapp.conf).
#
# embarch-dev-bench/design.md §3 decision [interim ESP32-C5]: temporary
# substitute dev-bench board while the real nRF54L15DK replacement is in
# transit (broken unit RMA'd, ETA ~1 week from 2026-08-19). Values below were
# *not* blindly copied from the Nordic file -- each was checked empirically
# against a real `west build` for this board; see that decision's own text
# for what differed and why.
CONFIG_BT=y
CONFIG_BT_PERIPHERAL=y
CONFIG_BT_CENTRAL=y
CONFIG_BT_SMP=y
CONFIG_BT_DEVICE_NAME="embarch-dev-bench"

# BT_ESP32 (drivers/bluetooth/hci/Kconfig.esp32) is the HCI driver for
# Espressif's own BLE controller blob (libble_app.a etc., fetched via
# `west blobs fetch hal_espressif`) -- it is *not* directly settable here
# (empirically: "is assigned in a configuration file, but is not directly
# user-configurable (has no prompt)" -- it has no `prompt` in its Kconfig
# entry). It gets selected automatically once CONFIG_BT is on for a board
# whose SoC provides it, so no line for it belongs in this file at all.

# Unlike the nRF54L15DK (SoftDevice Controller, BT_MAX_CONN=2 needed because
# central/peripheral slots are carved out of one pool), Espressif's ESP32
# controller budgets central and peripheral connections independently
# (ESP32_BT_CTLR_LE_MAX_CONN, default 3) -- BT_MAX_CONN=2 here is just "one
# central + one peripheral link," not a controller-slot workaround.
CONFIG_BT_MAX_CONN=2

CONFIG_BT_GATT_CLIENT=y
CONFIG_BT_GATT_AUTO_DISCOVER_CCC=y

# Same reasoning as the nRF54L15DK conf: every BLE action runs synchronously
# on the main thread, blocking on semaphores across discovery/read/write and
# building advertising data on its stack.
#
# Real bug found and fixed, Milestone 3 (Study Designer: Feature-Branch
# Iteration): this line used to read 2048, silently overriding the shared
# app/prj.conf's own CONFIG_MAIN_STACK_SIZE=8192 -- Zephyr's board-conf
# fragment is merged *after* prj.conf, so the later value wins with no
# warning either build ever surfaced. Confirmed empirically against a real
# build's resolved build/zephyr/.config (2048, not 8192) before this fix.
# Harmless while dispatch_study only ever ran Action::BleAdvertise (a
# shallow call chain), but real Action::GattDiscover/GattMonitorAll dispatch
# (embarch-study-designer/design.md §3 decisions 31/32) is the first time
# this main thread's call depth actually reaches into BLE central-role GATT
# discovery/subscribe code -- restoring prj.conf's already-vetted margin here
# rather than leaving a real hardware build silently running a quarter of it.
CONFIG_MAIN_STACK_SIZE=8192

# Deliberately not setting CONFIG_BT_SETTINGS -- same RAM-only bonding-table
# posture as the nRF54L15DK conf (decision 11), unaffected by which board is
# running the firmware.

# --- GATT transcript (embarch-dev-bench/design.md §3 decision 36) ---
#
# ble_bridge_real.c's transcript_emit() builds one `struct
# ble_transcript_entry` (~290 bytes) as a stack local, deliberately rather
# than in a shared static: it is called from both the BT RX thread (anything
# inbound) and whichever thread called ble_bridge_execute, and a shared
# staging buffer would tear under a notification arriving mid-emit. Zephyr's
# default BT RX stack has no room for that frame on top of the GATT
# discovery/subscribe call depth already running there, so it is raised here
# rather than left to fail as an intermittent stack overflow under exactly
# the notification bursts this feature exists to capture.
CONFIG_BT_RX_STACK_SIZE=3072

# One ATT MTU's worth of notification is what DBM_MAX_TRANSCRIPT_PAYLOAD_LEN
# (serial_protocol.h) is sized for. Zephyr's defaults (L2CAP TX MTU 65) would
# cap a single notification at 62 bytes, silently fragmenting anything longer
# -- a shell/NUS response most of all -- into rows that each look like a
# separate event. 247 is the usual practical ceiling for one LL PDU with data
# length extension, and 244 = 247 - 3 bytes of ATT header.
CONFIG_BT_L2CAP_TX_MTU=247
CONFIG_BT_BUF_ACL_RX_SIZE=251
CONFIG_BT_BUF_ACL_TX_SIZE=251
```

## boards/native_sim.conf
```kconfig
# native_sim-specific Kconfig (embarch-dev-bench/design.md §3 decision 16).
# ble_bridge_stub.c pulls in no Zephyr BT Kconfig at all.
#
# native_sim's `zephyr,console` chosen node (uart0, "zephyr,native-pty-uart")
# only gets a real uart_poll_in/uart_poll_out-capable driver instance when
# CONFIG_SERIAL is on -- without it, the board falls back to a raw POSIX
# console with no standard UART device at all, which main.c's DEVICE_DT_GET
# needs. This is Zephyr's own native UART peripheral emulation (backed by a
# host PTY under the hood), not a bespoke test transport of our own --
# decision 16's "no virtual-PTY serial transport" is about not building extra
# test-only plumbing on top of this, not about avoiding native_sim's normal
# UART support.
CONFIG_SERIAL=y
CONFIG_UART_NATIVE_PTY=y

# --- logging (embarch-dev-bench/design.md §3 decision 38) ----------------
#
# Deliberately NOT turning off CONFIG_LOG_BACKEND_NATIVE_POSIX, unlike the
# UART and RTT backends the shared prj.conf disables. That backend writes to
# the host process's *stdout*, and this board's link is a separate PTY
# (CONFIG_UART_NATIVE_PTY above), so it cannot corrupt COBS framing the way
# LOG_BACKEND_UART would on a real board -- and having log records visible in
# the terminal that launched zephyr.exe is exactly what a host-side sanity
# board is for. Confirmed by reading the resolved build/zephyr/.config, not
# assumed: NATIVE_POSIX is the only other backend this board enables.
```

## boards/nrf54l15dk_nrf54l15_cpuapp.conf
```kconfig
# nRF54L15DK-specific Kconfig, auto-merged by Zephyr's build system for board
# target nrf54l15dk/nrf54l15/cpuapp (filename matches the full target with
# slashes replaced by underscores -- Zephyr's standard board-conf-fragment
# convention, no extra CMake wiring needed).
#
# embarch-dev-bench/design.md §3 decisions 3/5/11: SoftDevice Controller,
# Just Works pairing, bonds RAM-only (achieved simply by never enabling
# CONFIG_BT_SETTINGS below -- Zephyr's default without it is RAM-only).
CONFIG_BT=y
CONFIG_BT_PERIPHERAL=y
CONFIG_BT_CENTRAL=y
CONFIG_BT_SMP=y
CONFIG_BT_DEVICE_NAME="embarch-dev-bench"

# Two link slots, not one -- and NOT a relaxation of design decision 15's
# one-DUT-at-a-time rule. With the SoftDevice Controller, the central role gets
# `BT_MAX_CONN - BT_CTLR_SDC_PERIPHERAL_COUNT` slots (nrf/subsys/bluetooth/
# controller/Kconfig), and PERIPHERAL_COUNT defaults to 1 whenever
# BT_PERIPHERAL is on -- so BT_MAX_CONN=1 would leave the central role zero
# slots and break every central-role BleConnect, while still building cleanly.
# Two is also NCS's own default for this exact combination. The
# one-connection-at-a-time invariant is enforced in ble_bridge_real.c's
# execute_connect (it refuses to open a second link), not by this budget.
CONFIG_BT_MAX_CONN=2

# ble_bridge_real.c's DataExchange path acts as a GATT *client* against the DUT:
# service/characteristic discovery, read, write-with-response, and
# notify/indicate subscriptions. BT_CENTRAL alone doesn't bring the client role
# in.
CONFIG_BT_GATT_CLIENT=y
# Lets bt_gatt_subscribe() find a characteristic's CCC descriptor itself
# (subscribe_params.ccc_handle = BT_GATT_AUTO_DISCOVER_CCC_HANDLE), so
# ble_bridge_real.c doesn't need a third hand-rolled discovery pass. The
# subscribe_params fields it uses for that (end_handle/disc_params) only exist
# when this is enabled -- turning it off is a compile error there, not a
# silent behavior change.
CONFIG_BT_GATT_AUTO_DISCOVER_CCC=y

# Every BLE action runs synchronously on the main thread, which now waits on
# semaphores across discovery/read/write instead of returning immediately, and
# builds advertising data on its stack. 2 KiB leaves headroom over the nRF
# default (1 KiB) for that.
#
# Real bug found and fixed, Milestone 3 (Study Designer: Feature-Branch
# Iteration): this line used to silently override the shared app/prj.conf's
# own CONFIG_MAIN_STACK_SIZE=8192, since Zephyr merges a board-conf fragment
# *after* prj.conf and the later value wins with no warning -- confirmed
# empirically via the espressif board's own resolved .config before this fix
# (the identical bug, same root cause, present in this file too). Restoring
# prj.conf's already-vetted margin here now that real GATT-discovery dispatch
# (embarch-study-designer/design.md §3 decisions 31/32) is the first thing to
# actually exercise this main thread's deeper BLE-central call chains.
CONFIG_MAIN_STACK_SIZE=8192

# NOT setting CONFIG_BT_SETTINGS (and therefore not CONFIG_SETTINGS/CONFIG_FLASH
# either) is what keeps the BT bonding table RAM-only, per decision 11 --
# there is deliberately no flash-backed persistence to opt into here.

# --- GATT transcript (embarch-dev-bench/design.md §3 decision 36) ---
#
# ble_bridge_real.c's transcript_emit() builds one `struct
# ble_transcript_entry` (~290 bytes) as a stack local, deliberately rather
# than in a shared static: it is called from both the BT RX thread (anything
# inbound) and whichever thread called ble_bridge_execute, and a shared
# staging buffer would tear under a notification arriving mid-emit. Zephyr's
# default BT RX stack has no room for that frame on top of the GATT
# discovery/subscribe call depth already running there, so it is raised here
# rather than left to fail as an intermittent stack overflow under exactly
# the notification bursts this feature exists to capture.
CONFIG_BT_RX_STACK_SIZE=3072

# One ATT MTU's worth of notification is what DBM_MAX_TRANSCRIPT_PAYLOAD_LEN
# (serial_protocol.h) is sized for. Zephyr's defaults (L2CAP TX MTU 65) would
# cap a single notification at 62 bytes, silently fragmenting anything longer
# -- a shell/NUS response most of all -- into rows that each look like a
# separate event. 247 is the usual practical ceiling for one LL PDU with data
# length extension, and 244 = 247 - 3 bytes of ATT header.
CONFIG_BT_L2CAP_TX_MTU=247
CONFIG_BT_BUF_ACL_RX_SIZE=251
CONFIG_BT_BUF_ACL_TX_SIZE=251
```

## boards/esp32c5_devkitc_esp32c5_hpcore.overlay
```dts
/*
 * ESP32-C5-WROOM-1 interim dev-bench board (embarch-dev-bench/design.md's
 * ESP JTAG interim decision). Auto-merged by Zephyr's board devicetree
 * overlay convention (flat filename matching the board target, same as this
 * board's own .conf fragment) -- no extra CMake wiring needed.
 *
 * Second real end-to-end finding on this exact link, Milestone 3 (Study
 * Designer: Feature-Branch Iteration), 2026-08-20 -- this file previously
 * repointed the console/protocol link at `usb_serial` (the native USB
 * JTAG/serial peripheral, same physical USB-C port used for JTAG flashing),
 * because `uart0`'s header pins were believed disconnected from anything
 * the host could reach. That's wrong for this specific board: the
 * ESP32-C5-DevKitC-1 has a *second* USB-C port, wired to `uart0` through its
 * own onboard USB-UART bridge chip, entirely separate from the native USB
 * JTAG/serial port both live in the same DTS as `zephyr,console = &uart0`
 * (the board's own upstream default) already assumed. Found live: the first
 * real `run_study` against `usb_serial` got past Core's dev-bench port
 * *detection* (unambiguous once `EMBARCH_DEV_BENCH_SERIAL` was set) but
 * failed decoding `HelloAck` -- consistent with the native USB JTAG/serial
 * peripheral's poll-mode driver not reliably carrying this link's 1 Mbaud
 * binary protocol, not a framing/logic bug (`CONFIG_LOG=n`, no stray
 * `printk` on this path -- checked, not assumed). Switching back to the
 * board's own default console (`uart0`, over its dedicated UART USB-C port)
 * tests that theory with zero rewiring: both USB-C ports stay connected,
 * JTAG flashing/reset keep using the native one, the protocol link moves to
 * the UART one. `current-speed` overridden to 1 Mbaud here (the upstream
 * default of 115200 predates this link needing to match
 * `embarch-core::dev_bench_link::DEV_BENCH_BAUD`). `usb_serial` is left
 * enabled -- harmless if unused, and JTAG/flashing over that same physical
 * port is unaffected by what Zephyr's console is chosen to.
 */

&uart0 {
	current-speed = <1000000>;
};
```

## boards/nrf54l15dk_nrf54l15_cpuapp.overlay
```dts
/*
 * nRF54L15DK dev-bench board (embarch-dev-bench/design.md §3 decision 26's
 * successor -- this board is the dev bench again as of 2026-08-31). Auto-
 * merged by Zephyr's board devicetree overlay convention (flat filename
 * matching the board target, same as this board's own .conf fragment and as
 * the ESP32-C5's overlay) -- no extra CMake wiring needed.
 *
 * The only thing this file has to say is the baud rate. `zephyr,console` on
 * this board is already `&uart20` (nrf54l_05_10_15_cpuapp_common.dtsi's own
 * chosen block), wired through the DK's onboard J-Link OB to VCOM1, USB
 * interface 2 (decision 43: enrol it with `link_port_interface = 2`) -- so
 * unlike the ESP32-C5, which had to be moved off its native USB-Serial/JTAG
 * peripheral onto a separate bridge chip, nothing here needs repointing.
 * What does need overriding is `current-speed`: the board's upstream default
 * is 115200, and this link must match `embarch-core::dev_bench_link::
 * DEV_BENCH_BAUD` (1 Mbaud) exactly or Core's very first `Hello` fails to
 * decode.
 *
 * uart30 is left at its own 115200 default and unused, and it is
 * deliberately NOT given a role here:
 * app/prj.conf's decision-7 block turns off every log backend that would
 * write raw text, so there is nothing left that wants a second console, and
 * a second enabled UART would only add a candidate for
 * `embarch-topology`'s port detection to have to disambiguate.
 */

&uart20 {
	current-speed = <1000000>;
	/* **Hardware flow control, because this link silently loses bytes
	 * without it.** At 1 Mbaud the host driver's default ~4 KB receive
	 * buffer holds about 40 ms of traffic, so any stall longer than that on
	 * Core's side drops a contiguous run of bytes mid-frame. COBS resyncs at
	 * the next delimiter and the frame is simply gone; ordinary
	 * DevBenchMessages carry no CRC (only `Study` does), so nothing detects
	 * it except a decode failure. A 10 h PPG drain lost three
	 * `StreamChunkBatch` frames that way -- 976 bytes, four 244-byte
	 * notifications, 3 of 598 records damaged -- and the capture was
	 * reported `truncated: false`.
	 *
	 * Core reading on its own thread (embarch-core's `dev_bench_link`)
	 * removes the stall this firmware was paying for; CTS is what makes the
	 * loss structurally impossible rather than merely unlikely, since
	 * `uart_poll_out` then waits for the host instead of writing into a full
	 * buffer.
	 *
	 * The DK already assigns the pins: `uart20_default` carries UART_RTS on
	 * P1.06 and UART_CTS on P1.07 alongside TX P1.04 / RX P1.05, routed
	 * through the onboard J-Link OB to VCOM1. Nothing here rewires
	 * anything -- it only asks the UARTE to honour lines the board file
	 * already declared. */
	hw-flow-control;
};
```

## src/ble_bridge_stub.c
```c
/* No-BLE-host stub, built by workspaces/native_sim/ (embarch-dev-bench/design.md
 * §3 decision 16). Every action reports a canned Pass outcome — this exists so
 * the serial/dispatch flow (main.c) is exercisable on a host machine with no
 * radio at all, not to model real BLE behavior.
 *
 * Kept in signature-sync with ble_bridge_real.c by hand, which is decision 16's
 * accepted cost for keeping the real BLE-host code free of stub-only branches.
 */
#include <stddef.h>

#include "ble_bridge.h"

/* The GATT transcript sink (design.md §3 decision 36): stored so the setter
 * behaves identically on both sides of the decision-16 split, never
 * invoked, because a canned Pass observed no GATT traffic to transcribe.
 * Emitting invented entries here would let a native_sim run produce a
 * transcript indistinguishable from a real capture -- exactly the failure this
 * stub's "no captured_data either" rule already guards against. */
static ble_transcript_sink transcript_sink;
static ble_log_sink log_sink;
static void *transcript_user_data;

int ble_bridge_init(void)
{
	return 0;
}

struct outcome ble_bridge_execute(const struct action *action, uint32_t timeout_ms)
{
	(void)action;
	(void)timeout_ms;
	/* No captured_data either: a canned Pass has no DUT bytes behind it, and
	 * inventing some would let a native_sim run look like it exchanged real
	 * data.
	 *
	 * And no `security_level` (embarch-study-designer/design.md §3 decision
	 * 44), for exactly the
	 * same reason and more sharply: there is no link here, so there is no
	 * level. A stub that reported L4 would let a native_sim run produce a
	 * StepResult indistinguishable from a real authenticated pairing --
	 * the one claim this suite must never manufacture. `has_security_level`
	 * stays false, which reads as "there was no connection to ask about",
	 * which is the truth.
	 *
	 * And no `protocol` either (embarch-study-designer/design.md §3
	 * decision 62), for the same reason a third time and the sharpest one
	 * yet: an ACTION_RUN_PROTOCOL step here runs no state machine, so there
	 * is no state it stopped in. `has_protocol` stays false, which reads as
	 * "no protocol ran", which is the truth. Reporting a `done` here would
	 * let a native_sim run produce a StepResult indistinguishable from a
	 * real handshake completing against a real DUT -- and the interpreter's
	 * own semantics are covered where they can be covered honestly, by
	 * app/tests/serial_protocol driving eap_interp.c directly. */
	return (struct outcome){.kind = OUTCOME_PASS};
}

void ble_bridge_set_log_sink(ble_log_sink sink, void *user_data)
{
	log_sink = sink;
	(void)user_data;
	(void)log_sink;
}

void ble_bridge_set_transcript_sink(ble_transcript_sink sink, void *user_data)
{
	transcript_sink = sink;
	transcript_user_data = user_data;
}

/* The stub has no radio and therefore no notification queue to overflow, so
 * it accepts the registration and never calls it -- the same posture every
 * other sink here takes. */
void ble_bridge_set_drop_sink(ble_drop_sink sink, void *user_data)
{
	(void)sink;
	(void)user_data;
}

bool ble_bridge_monitor_window_open(void)
{
	/* No window is ever opened here, so main.c never has one to close. */
	return false;
}

void ble_bridge_clear_bonds(void)
{
	/* No bonding table without a BT host. */
}

void ble_bridge_reset(void)
{
	(void)transcript_sink;
	(void)transcript_user_data;
}
```

## src/dev_bench_log.h
```c
/* Zephyr log backend that forwards this firmware's `CONFIG_LOG` output to
 * Core over the existing `LogLine` DevBenchMessage.
 *
 * embarch-dev-bench/design.md §3 decision 7 already routes dev-bench's own
 * log output through `LogLine` rather than raw text on the shared wire, and
 * §3 decision 38 is what finally turns `CONFIG_LOG` itself on: until then the
 * only things that reached Core were the handful of hand-written
 * `send_log_line()` diagnostics, and every `LOG_INF`/`LOG_ERR` in Zephyr's own
 * subsystems (BT host, drivers) plus every fatal-error dump was compiled out
 * entirely -- which is exactly why "did this bench reboot mid-study" was not a
 * question anything observable could answer (see main.c's handle_hello).
 *
 * The backend deliberately knows nothing about the UART, the message union, or
 * main.c: it formats a record into one bounded line and hands it to a sink
 * this header lets main.c install. That keeps the Zephyr-log glue linkable in
 * a ztest against a capturing sink (app/tests/dev_bench_log), and it is also
 * what implements the pre-handshake hold below.
 */
#ifndef EMBARCH_DEV_BENCH_LOG_H_
#define EMBARCH_DEV_BENCH_LOG_H_

#include <stdbool.h>
#include <stdint.h>

/* How many formatted lines are held while no sink is installed -- i.e. from
 * power-on until Core's first `Hello` (design.md §3 decision 38). Boot-time
 * records have nowhere to go before that: Core opens the serial port
 * per-study, so anything written to the wire beforehand is shifted out to
 * nobody. Holding them and flushing at handshake is what makes a reboot
 * visible from Core's side at all.
 *
 * Eight, not a rounder number: this is `8 * (DBM_MAX_LOG_LINE_LEN + 1)` = ~1
 * KB of static RAM on a board whose SRAM has already overflowed twice at link
 * time (design.md §3 decisions 27 and the tx_scratch consolidation in
 * main.c), and eight lines is enough for the boot record plus whatever a
 * subsystem says on its way up. Overflow drops the *oldest* and is counted,
 * then reported as its own line at flush time -- never silently.
 */
#define DEV_BENCH_LOG_BACKLOG_DEPTH 8

/* Installed by main.c. `line` is NUL-terminated and never longer than
 * `DBM_MAX_LOG_LINE_LEN` (serial_protocol.h), so a sink can hand it straight
 * to a `LogLine` without re-checking length.
 *
 * `panic` is true only on the fatal-error path, where the log subsystem has
 * switched to synchronous processing inside the faulting context: a sink must
 * then NOT take a mutex (k_mutex_lock from an ISR/fault context is illegal)
 * and should write directly, accepting that it may interleave with a frame
 * some now-halted thread had half-written. Getting the fault out is the whole
 * point at that stage, and Core resyncs on the next COBS delimiter anyway.
 */
typedef void (*dev_bench_log_sink_fn)(const char *line, bool panic);

/* Installs `sink` and flushes whatever the backlog holds, oldest first, plus
 * a line reporting any backlog drops. Called from main.c's handle_hello once
 * `HelloAck` is on the wire -- deliberately after it, so the very first frame
 * Core sees on a freshly booted bench is still the ack it is waiting for.
 *
 * Passing NULL detaches the sink and resumes holding lines in the backlog.
 */
void dev_bench_log_set_sink(dev_bench_log_sink_fn sink);

/* Test-only introspection (app/tests/dev_bench_log). Counts lines the backlog
 * dropped since the last flush, not since boot. */
uint32_t dev_bench_log_backlog_dropped(void);

/* ---- per-study verbosity (design.md §3 decision 39) -------------------- */

/* The level in force whenever no study is running: at boot, between studies,
 * and after a `Hello`. Warn-and-above, so the link is quiet while the bench is
 * idle and an error still cannot pass unnoticed.
 *
 * Decision 38 achieved this with CONFIG_LOG_DEFAULT_LEVEL, i.e. by *compiling
 * out* everything above it -- which made the choice once, for every study,
 * whoever last edited prj.conf. Decision 39 compiles everything in and filters
 * at runtime instead, so a single study can ask for more (see
 * `struct dbm_study_start.dev_bench_log_level`) without a reflash.
 */
#define DEV_BENCH_LOG_BOOT_LEVEL 2 /* DBM_LOG_LEVEL_WRN */

/* The module name main.c registers with LOG_MODULE_REGISTER.
 *
 * dev_bench_log.c holds this one module at INF even while a study asks for
 * less, because "the BT host should be quiet" is not the same request as "this
 * firmware should stop saying what it is doing" -- the boot record and the
 * handshake diagnostics are the whole reason decision 38 exists. The one
 * exception is an explicit `Off`, which means silent and is taken literally.
 *
 * Matched by string rather than by a shared source id because Zephyr exposes
 * no way to ask for another translation unit's log source id.
 */
#define DEV_BENCH_LOG_APP_MODULE "dev_bench"

/* Zephyr's kernel log module, and the ceiling this backend holds it at no
 * matter what a study asks for.
 *
 * **This is a feedback loop, not a noise preference, and it was found by
 * running a study at `Debug` on real hardware.** Forwarding a line takes
 * main.c's `link_tx_mutex` and writes the UART; the kernel logs
 * `z_impl_k_mutex_unlock` at DBG; that record is forwarded, which takes the
 * mutex again. The capture came back as an unbroken alternation of
 * `<dbg> os: z_impl_k_mutex_unlock` and `<wrn> log: 5 log record(s) dropped`
 * — the act of logging was generating the log, and the deferred buffer
 * overflowed continuously. `k_sleep`'s own `z_tick_sleep` feeds the same loop
 * from the dispatch loop's idle path.
 *
 * Capping `os` breaks it at the source. Nothing is lost that a study wanted:
 * these records are Zephyr's internal kernel tracing, not the bench's account
 * of the DUT, and a study asking for `Debug` is asking about the radio.
 */
#define DEV_BENCH_LOG_KERNEL_MODULE "os"
#define DEV_BENCH_LOG_KERNEL_CEILING 2 /* DBM_LOG_LEVEL_WRN */

/* Applies `level` (a DBM_LOG_LEVEL_* value, which is also the Zephyr severity
 * number -- see serial_protocol.h) to every log source, subject to the
 * DEV_BENCH_LOG_APP_MODULE rule above.
 *
 * Returns the highest level actually reached. Zephyr's `log_filter_set` clamps
 * a request to what the build compiled in, so a returned value *below* `level`
 * means this firmware was built without that verbosity — reported rather than
 * silently accepted, since "I asked for debug and got warnings" is exactly the
 * kind of thing that otherwise reads as the feature not working.
 */
uint8_t dev_bench_log_set_level(uint8_t level);

#endif /* EMBARCH_DEV_BENCH_LOG_H_ */
```

## src/eap_interp.h
```c
/* The `.eap` protocol interpreter -- `embarch-study-designer` decisions
 * 58-62.
 *
 * # This is the executor, and the Rust one is the specification
 *
 * That doc's decision 60 puts the **real** interpreter here rather than in
 * Core: the loop closes against the DUT's own BLE connection interval, Core
 * still sends nothing after `StudyStart`, and main.c's receive-then-run model
 * is unchanged. What lives in `embarch-study-designer/src/eap_interp.rs` is
 * the *reference* -- the semantics this file has to agree with, executable so
 * a cross-language test can pin them. Where the two disagree, that crate is
 * right, exactly as it is for the wire encoding.
 *
 * The division is the one `embarch-study-designer` decisions 59/60 already set: the wire types and
 * the reference semantics live in the crate, live BLE dispatch lives here.
 *
 * # Events in, instructions out -- and no radio anywhere
 *
 * Nothing in this module opens a connection, subscribes to anything, or knows
 * what time it is. A caller feeds it arrivals and timer expiries and reads
 * back the writes it wants performed. That is deliberate and it is what makes
 * the semantics testable on a host: every branch below -- the
 * `remember`-before-guards ordering, first-guard-wins, saturating `+`, an
 * unresolvable operand making a guard false and a write not happen, `retry`
 * re-running `on_enter` rather than waiting longer -- is exercised by
 * app/tests/serial_protocol without a DUT in the room.
 *
 * # One behavior that is easy to get wrong, because it already was once
 *
 * An `on_event` arm with **no** `otherwise` consumes the frame, applies its
 * `remember`s, and stays in the state *without re-entering it*: no `on_enter`
 * re-send, and the timeout keeps counting from the original entry.
 * `otherwise: goto <this state>` is a different thing -- it re-enters, which
 * re-sends the flow-control ack and restarts the stall watchdog. A
 * flow-controlled pump loop needs the second, and the first draft of the
 * crate's own fixture wrote the first: it consumed every chunk correctly,
 * acked none of them, and stalled at the watchdog. See
 * embarch-decision-reversals.md row 66.
 */
#ifndef EMBARCH_DEV_BENCH_EAP_INTERP_H_
#define EMBARCH_DEV_BENCH_EAP_INTERP_H_

#include <stdbool.h>
#include <stddef.h>
#include <stdint.h>

#include "eap.h"

/* Mirrors `Outcome` (embarch-study-designer/src/result.rs). `TimedOut` is the
 * one a manifest cannot declare and only a run can produce. */
enum eap_outcome_tag {
	EAP_OUTCOME_PASS = 0,
	EAP_OUTCOME_FAIL = 1,
	EAP_OUTCOME_TIMED_OUT = 2,
};

/* The `fail_reason` of a run whose manifest names something it does not have:
 * a `when … goto`, `otherwise` or `on_timeout` naming no state, or a
 * `remember` naming no session variable. The run fails in the state that
 * named it. No comma and no quote -- the CSV rule every reason follows. */
#define EAP_FAIL_NO_SUCH_STATE    "protocol goto names no state"
#define EAP_FAIL_NO_SUCH_VARIABLE "protocol remember names no session variable"

/* Largest `write` payload a manifest can assemble: every field of an
 * `on_enter` write at its widest. Sized from the grammar rather than borrowed
 * from the link protocol's own DBM_MAX_PAYLOAD_LEN, which would be 512 bytes
 * of stack for a
 * control-point opcode and an argument. */
#define EAP_MAX_WRITE_PAYLOAD_LEN (EAP_MAX_WRITE_FIELDS * 8)

/* Something that happened, from the interpreter's point of view. */
enum eap_event_kind {
	/* A notification arrived on the characteristic bound to this source
	 * index, carrying these bytes. */
	EAP_EVENT_NOTIFY = 0,
	/* The current state's `on_timeout` deadline expired. */
	EAP_EVENT_TIMEOUT = 1,
};

struct eap_event {
	uint8_t kind;   /* enum eap_event_kind */
	uint8_t source; /* index into eap_protocol_def.sources; NOTIFY only */
	const uint8_t *payload;
	size_t payload_len;
};

/* What the caller should do next. */
enum eap_step_kind {
	/* Perform a GATT write of `payload` to `source`, then wait. */
	EAP_STEP_WRITE = 0,
	/* Wait for the next event. */
	EAP_STEP_WAIT = 1,
	/* The machine reached a terminal state, or was abandoned. */
	EAP_STEP_DONE = 2,
};

/* One instruction.
 *
 * **A write's own ATT response is never fed back in.** There is no event for
 * one, deliberately (`embarch-study-designer` decision 60): on the DUT this was designed
 * against, a control-point write's response confirms only that the write was
 * *accepted*, and the authoritative answer arrives later as an independent
 * notification on a different characteristic. This says what to send; only a
 * notification or a timeout moves the machine.
 */
struct eap_step {
	uint8_t kind; /* enum eap_step_kind */

	/* EAP_STEP_WRITE */
	uint8_t source;
	bool with_response;
	uint8_t payload[EAP_MAX_WRITE_PAYLOAD_LEN];
	size_t payload_len;

	/* EAP_STEP_WRITE and EAP_STEP_WAIT: the state's own timeout, if it
	 * declared one. A write arms it too -- a write is not a state of its
	 * own, it is what entering a state does before it starts waiting. */
	bool has_deadline;
	uint32_t deadline_ms;

	/* EAP_STEP_DONE -- `ProtocolOutcome { final_state, outcome }`. */
	char final_state[EAP_MAX_STATE_NAME_LEN + 1];
	struct {
		uint8_t tag; /* enum eap_outcome_tag */
		char fail_reason[EAP_MAX_FAIL_REASON_LEN + 1];
	} outcome;
};

/* A protocol run in progress. Borrows `def` for its whole lifetime -- which
 * is one `Action::RunProtocol` step, and `def` lives in the decoded
 * `struct dbm_study_start` that outlives every step. */
struct eap_run {
	const struct eap_protocol_def *def;
	int64_t session[EAP_MAX_SESSION_VARS];
	uint8_t state;
	/* Retries already spent in the current state, reset on every entry --
	 * which is why `eap_run_enter` and the internal re-entry an
	 * `on_timeout` retry performs are not the same call. */
	uint8_t retries;
	bool finished;
};

/* Start a run at `entry_state`, initialising every session variable to its
 * declared value. Returns 0, or -1 if `entry_state` is out of range -- which
 * `validate_protocol` and Core's pre-flight both check before this can be
 * reached, so it is belt and braces rather than the real defence. */
int eap_run_start(struct eap_run *run, const struct eap_protocol_def *def, uint8_t entry_state);

/* What to do on entering the current state. Call once after `eap_run_start`;
 * the machine calls it for itself on every transition. */
void eap_run_enter(struct eap_run *run, struct eap_step *out);

/* Feed one event and get the next instruction. */
void eap_run_on_event(struct eap_run *run, const struct eap_event *ev, struct eap_step *out);

/* End the run because the *step's* own `timeout_ms` expired before the
 * machine reached a terminal state. Reports `TimedOut` against whatever state
 * it was sitting in -- the one outcome no manifest can declare. */
void eap_run_abandon(struct eap_run *run, struct eap_step *out);

/* The state the run is currently in, as an index into `def->states`. */
uint8_t eap_run_state(const struct eap_run *run);

/* Session variables, in declaration order.
 *
 * Exposed for tests and for offline replay, and **not** reported in
 * `ProtocolOutcome` -- `embarch-study-designer` decision 62 kept decoded values out of a
 * result on purpose, and a session variable is a decoded value that survived.
 * Mirrors `Run::session()` in the Rust reference, which exists for the same
 * two callers and neither of them is the wire. */
const int64_t *eap_run_session(const struct eap_run *run);

#endif /* EMBARCH_DEV_BENCH_EAP_INTERP_H_ */
```
