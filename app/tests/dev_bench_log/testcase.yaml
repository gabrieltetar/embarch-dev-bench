## app/tests/dev_bench_log/testcase.yaml
```yaml
tests:
  embarch_dev_bench.dev_bench_log:
    platform_allow: native_sim
    tags: embarch_dev_bench
```

## app/tests/scan_seen_names/testcase.yaml
```yaml
tests:
  embarch_dev_bench.scan_seen_names:
    platform_allow: native_sim
    tags: embarch_dev_bench
```

## app/tests/serial_protocol/testcase.yaml
```yaml
tests:
  embarch_dev_bench.serial_protocol:
    platform_allow: native_sim
    tags: embarch_dev_bench
```

## pd-bench/tests/logic/testcase.yaml
```yaml
tests:
  pd_bench.logic:
    platform_allow: native_sim
    integration_platforms:
      - native_sim
    tags: pd_bench
```
